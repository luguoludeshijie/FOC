/*******************************************************************************
*
* 文件名称: Task.c
* 版 本 号: V1.0 
* 作    者: linbo.liu
* 生成日期: 2024年x月x日
* 功能描述: 
*
*******************************************************************************/
/*******************************************************************************
 *----------------------------------头文件--------------------------------------
 ******************************************************************************/
#include "Srv.h"

/*******************************************************************************
 *----------------------------------宏定义---------------------------------------
 ******************************************************************************/


/*******************************************************************************
 *--------------------------------数据类型定义-----------------------------------
 ******************************************************************************/


/*******************************************************************************
 *----------------------------------函数声明-------------------------------------
 ******************************************************************************/


/*******************************************************************************
 *-----------------------------------常量定义------------------------------------
 ******************************************************************************/


/*******************************************************************************
 *-----------------------——--------全局变量定义----------------------------------
 ******************************************************************************/
Sys_Task_T g_Task;

/*******************************************************************************
 *---------------------------—----—--函数实现------------------------------------
 ******************************************************************************/
/*******************************************************************************
* 函 数 名: Sys_TaskInit
* 功能描述: 任务初始化
* 输入参数: arg_Cb：任务回调
* 输出参数: void
*******************************************************************************/
void Sys_TaskInit(TaskPtr arg_Cb[])
 {
    g_Task.xTask[0].usCurTimer  = TIME_500US;
    g_Task.xTask[0].usRunCycle  = TIME_500US;
    g_Task.xTask[0].uIsRunning  = FALSE;
    g_Task.xTask[0].pTask       = arg_Cb[0];

    g_Task.xTask[1].usCurTimer  = TIME_1MS;
    g_Task.xTask[1].usRunCycle  = TIME_1MS;
    g_Task.xTask[1].uIsRunning  = FALSE;
    g_Task.xTask[1].pTask       = arg_Cb[1];    

    g_Task.xTask[2].usCurTimer  = TIME_5MS;
    g_Task.xTask[2].usRunCycle  = TIME_5MS;
    g_Task.xTask[2].uIsRunning  = FALSE;
    g_Task.xTask[2].pTask       = arg_Cb[2];

    g_Task.xTask[3].usCurTimer  = TIME_10MS;
    g_Task.xTask[3].usRunCycle  = TIME_10MS;
    g_Task.xTask[3].uIsRunning  = FALSE;
    g_Task.xTask[3].pTask       = arg_Cb[3];

    g_Task.xTask[4].usCurTimer  = TIME_20MS;
    g_Task.xTask[4].usRunCycle  = TIME_20MS;
    g_Task.xTask[4].uIsRunning  = FALSE;
    g_Task.xTask[4].pTask       = arg_Cb[4];

    g_Task.xTask[5].usCurTimer  = TIME_100MS;
    g_Task.xTask[5].usRunCycle  = TIME_100MS;
    g_Task.xTask[5].uIsRunning  = FALSE;
    g_Task.xTask[5].pTask       = arg_Cb[5];

    g_Task.xTask[6].usCurTimer  = TIME_1000MS;
    g_Task.xTask[6].usRunCycle  = TIME_1000MS;
    g_Task.xTask[6].uIsRunning  = FALSE;
    g_Task.xTask[6].pTask       = arg_Cb[6];

    g_Task.usTickCycle          = TIME_1MS;
    g_Task.usTickTimer          = TIME_1MS;
    g_Task.ullSysTick           = TIME_ZERO;
 }
/*******************************************************************************
* 函 数 名: HAL_TIM_PeriodElapsedCallback
* 功能描述: 定时器回调
* 输入参数: htim
* 输出参数: void
*******************************************************************************/
void HAL_TIM_PeriodElapsedCallback(TIM_HandleTypeDef *htim)
{
    if(htim->Instance == TIM6)
    {
        g_Task.usTickTimer--;
        if(!g_Task.usTickTimer)
        {
            g_Task.usTickTimer = g_Task.usTickCycle;
            g_Task.ullSysTick++;
        }
        for(uint8_t i = 0; i < TASK_MAX; i++)
        {
            g_Task.xTask[i].usCurTimer--;
            if(!g_Task.xTask[i].usCurTimer)
            {
                g_Task.xTask[i].uIsRunning = TRUE;
                g_Task.xTask[i].usCurTimer = g_Task.xTask[i].usRunCycle;
            }
        }
    }
}

/*******************************************************************************
* 函 数 名: Sys_GetTick
* 功能描述: 获取系统Tick
* 输入参数: void
* 输出参数: void
*******************************************************************************/
uint64_t Sys_GetTick(void)
{
    return g_Task.ullSysTick;
}
/*******************************************************************************
* 函 数 名: OS_Task
* 功能描述: 用于系统运行
* 输入参数: void
* 输出参数: void
*******************************************************************************/
void OS_Task(void)
{
    for(uint8_t i = 0; i < TASK_MAX; i++)
    {
        if(g_Task.xTask[i].uIsRunning)
        {
            g_Task.xTask[i].uIsRunning = FALSE;

            if(g_Task.xTask[i].pTask)
            {
                g_Task.xTask[i].pTask();
            }
        }
    }
}

/*******************************************************************************
 *---------------------------—----—---结束--------------------------------------
 ******************************************************************************/