/*******************************************************************************
*
* 文件名称: Motor_Svpwm.c
* 版 本 号: V1.0 
* 作    者: linbo.liu
* 生成日期: 2024年x月x日
* 功能描述: 
*
*******************************************************************************/
/*******************************************************************************
 *----------------------------------头文件--------------------------------------
 ******************************************************************************/
#include "Srv.h"


/*******************************************************************************
 *----------------------------------宏定义---------------------------------------
 ******************************************************************************/


/*******************************************************************************
 *--------------------------------数据类型定义-----------------------------------
 ******************************************************************************/


/*******************************************************************************
 *----------------------------------函数声明-------------------------------------
 ******************************************************************************/


/*******************************************************************************
 *-----------------------------------常量定义------------------------------------
 ******************************************************************************/


/*******************************************************************************
 *-----------------------——--------全局变量定义----------------------------------
 ******************************************************************************/
/*******************************************************************************
 *---------------------------—----—--函数实现------------------------------------
 ******************************************************************************/
/*******************************************************************************
* 函 数 名: SVPWM_Cale
* 功能描述: SVPWM是7段式矢量调试，扇区与输出电压占空比经过简化后为对称输出，1和4，2和5，3和6对称
			文档给出是按照7段式SVPWM一点点按照矢量调制原理推到，中间推到有Uabc的三相电压
			T1和T1作用时间，Txyz时间最终等效Tabc三相输入占空比,
			Udc/√3=1，  单位1
			调制利用率等于(1-0.04)=0.96=96%
			Ualpha和Ubeta是和uq ud等幅值变换
* 输入参数: void
* 输出参数: void
*******************************************************************************/
void SVPWM_Cale(SVPWM_PARA_T *pV)
{
	pV->tmp[0] = pV->Ubeta; // 相当于二相静止坐标--到三相静止变换出Uabc
	pV->tmp[1] = pV->Ubeta * 0.5f + pV->Ualpha * 0.8660254f;
	pV->tmp[2] = pV->tmp[1] - pV->tmp[0]; // 三相逆变换和网上公式极性不同，
									// 本方法的SVPWM的扇区判断不同1--6/对应0--360，均匀分布
	pV->VecSector = 3;				// 根据三相电压符号计算矢量扇区
	pV->VecSector = (pV->tmp[1] > 0) ? (pV->VecSector - 1) : pV->VecSector;
	pV->VecSector = (pV->tmp[2] > 0) ? (pV->VecSector - 1) : pV->VecSector;
	pV->VecSector = (pV->tmp[0] < 0) ? (7 - pV->VecSector) : pV->VecSector;

	if (pV->VecSector == 1 || pV->VecSector == 4) // 根据矢量扇区计算矢量占空比Tabc
	{
		pV->T[0] = pV->tmp[1];
		pV->T[1] = pV->tmp[0] - pV->tmp[2];
		pV->T[2] = -pV->tmp[1];
	}

	else if (pV->VecSector == 2 || pV->VecSector == 5)
	{
		pV->T[0] = pV->tmp[2] + pV->tmp[1];
		pV->T[1] = pV->tmp[0];
		pV->T[2] = -pV->tmp[0];
	}
	else if (pV->VecSector == 3 || pV->VecSector == 6)
	{
		pV->T[0] = pV->tmp[2];
		pV->T[1] = -pV->tmp[2];
		pV->T[2] = -(pV->tmp[0] + pV->tmp[1]);
	}
	else // 异常状态下的判断出的扇区 0---7或者其他就执行0电压矢量
	{
		pV->T[0] = 0;
		pV->T[1] = 0;
		pV->T[2] = 0;
	}
	// T[0]bc是在浮点数据正负  ， 电压，pV->T[0]/Svpwm_Km是标幺值计算，将Tabc计算成-1---1
	// 将占空比调节为-1---1   ，再讲PWM的半周期占空比值提出    (-1---1)*50%+50%=0---100%
	pV->SVPT[0] = (int16_t)(pV->T[0] * Svpwm_Km_Backw * PWM_HalfPer) + PWM_HalfPer; // 计算
	pV->SVPT[1] = (int16_t)(pV->T[1] * Svpwm_Km_Backw * PWM_HalfPer) + PWM_HalfPer;
	pV->SVPT[2] = (int16_t)(pV->T[2] * Svpwm_Km_Backw * PWM_HalfPer) + PWM_HalfPer;
}


/*******************************************************************************
 *---------------------------—----—---结束--------------------------------------
 ******************************************************************************/